## configs/ii-vi-beagle-bone-black_defconfig
```kconfig
BR2_arm=y
BR2_cortex_a8=y
BR2_ARM_EABIHF=y
BR2_ARM_FPU_NEON=y
BR2_ARM_INSTRUCTIONS_THUMB2=y
BR2_TOOLCHAIN_EXTERNAL=y
BR2_TARGET_GENERIC_HOSTNAME="ii-vi-linux"
BR2_TARGET_GENERIC_ISSUE="Welcome to II-VI Linux (Buildroot)"
BR2_TARGET_GENERIC_GETTY_PORT="ttyO0"
BR2_ROOTFS_POST_BUILD_SCRIPT="script/ii-vi-pre-build-script"
BR2_ROOTFS_POST_IMAGE_SCRIPT="script/ii-vi-post-build-script"
BR2_LINUX_KERNEL=y
BR2_LINUX_KERNEL_DEFCONFIG="omap2plus"
BR2_LINUX_KERNEL_UIMAGE_LOADADDR="80008000"
BR2_LINUX_KERNEL_DTS_SUPPORT=y
BR2_LINUX_KERNEL_INTREE_DTS_NAME="am335x-boneblack"
BR2_PACKAGE_BUSYBOX_SHOW_OTHERS=y
BR2_PACKAGE_GDB=y
BR2_PACKAGE_GDB_SERVER=y
BR2_PACKAGE_GDB_DEBUGGER=y
BR2_PACKAGE_BINUTILS=y
BR2_PACKAGE_BINUTILS_TARGET=y
BR2_PACKAGE_MAKE=y
BR2_PACKAGE_TREE=y
BR2_PACKAGE_TFTPD=y
BR2_PACKAGE_XINETD=y
BR2_PACKAGE_SUDO=y
BR2_PACKAGE_II_VI_APPLICATIONS=y
BR2_PACKAGE_MTHREAD_DEMO=y
BR2_PACKAGE_MPROCESS_DEMO=y
BR2_PACKAGE_INTERPROCESS_COMM=y
BR2_PACKAGE_II_VI_MODULES=y
BR2_PACKAGE_MTHREAD_DEMO_MOD=y
BR2_TARGET_ROOTFS_CPIO=y
BR2_TARGET_ROOTFS_CRAMFS=y
BR2_TARGET_ROOTFS_EXT2=y
BR2_TARGET_ROOTFS_JFFS2=y
BR2_TARGET_ROOTFS_JFFS2_NANDFLASH_512_16K=y
BR2_TARGET_ROOTFS_SQUASHFS=y
BR2_TARGET_UBOOT=y
BR2_TARGET_UBOOT_BOARDNAME="am335x_boneblack"
BR2_TARGET_UBOOT_FORMAT_IMG=y
BR2_TARGET_UBOOT_SPL=y
BR2_TARGET_UBOOT_SPL_NAME="MLO"
BR2_PACKAGE_HOST_UBOOT_TOOLS=y
```

## package/ii-vi/Config.in
```kconfig
source "package/ii-vi/applications/Config.in"
source "package/ii-vi/modules/Config.in"
```

## package/ii-vi/applications/Config.in
```kconfig
menuconfig BR2_PACKAGE_II_VI_APPLICATIONS
	bool "ii-vi applications"
	select BR2_PACKAGE_HELLO_WORLD
	select BR2_PACKAGE_I2C_APP
	select BR2_PACKAGE_I2C_RTC
	select BR2_PACKAGE_LED_APP
	select BR2_PACKAGE_TEST_SCRIPT

source "package/ii-vi/applications/hello_world/Config.in"
source "package/ii-vi/applications/i2c_app/Config.in"
source "package/ii-vi/applications/i2c_rtc/Config.in"
source "package/ii-vi/applications/led_app/Config.in"
source "package/ii-vi/applications/test_script/Config.in"
source "package/ii-vi/applications/mthread_demo/Config.in"
source "package/ii-vi/applications/mprocess_demo/Config.in"
source "package/ii-vi/applications/interprocess_comm/Config.in"
```

## package/ii-vi/applications/hello_world/Config.in
```kconfig
config BR2_PACKAGE_HELLO_WORLD
	bool "hello_world"
	depends on BR2_PACKAGE_II_VI_APPLICATIONS
	help
		hello_world is an application that prints "Hello world" test messages 
		on standard output
```

## package/ii-vi/applications/i2c_app/Config.in
```kconfig
config BR2_PACKAGE_I2C_APP
	bool "i2c_app"
	depends on BR2_PACKAGE_II_VI_APPLICATIONS
	help
		i2c_app is an command based application for I2C master on BeagleBone 
		Black.
```

## package/ii-vi/applications/i2c_rtc/Config.in
```kconfig
config BR2_PACKAGE_I2C_RTC
	bool "i2c_rtc"
	depends on BR2_PACKAGE_II_VI_APPLICATIONS
	help
		i2c_rtc is an I2C based RTC application working on BeagleBone Black.
```

## package/ii-vi/applications/interprocess_comm/Config.in
```kconfig
config BR2_PACKAGE_INTERPROCESS_COMM
	bool "interprocess comm demo"
	depends on BR2_PACKAGE_II_VI_APPLICATIONS
	help
		"interprocess comm demo in c++" is an application that demonstrates the the inter-
		process/interthread communication using message queue, which is written in C++.
		
		Four different interprocess/interthread data communication methods are demonstrated:
		1. Pipe
		2. Named Pipe
		3. Message Queue
		4. Shared Memory
```

## package/ii-vi/applications/led_app/Config.in
```kconfig
config BR2_PACKAGE_LED_APP
	bool "led_app"
	depends on BR2_PACKAGE_II_VI_APPLICATIONS
	help
		led_app is an application for the control of the USR0 LED on 
		BeagleBone Black.
```

## package/ii-vi/applications/mprocess_demo/Config.in
```kconfig
config BR2_PACKAGE_MPROCESS_DEMO
	bool "multi-process programming demo"
	depends on BR2_PACKAGE_II_VI_APPLICATIONS
	help
		mprocess_demo is a demo program to show the multi-process programming
		API usage in embedded Linux environment.
```

## package/ii-vi/applications/mthread_demo/Config.in
```kconfig
config BR2_PACKAGE_MTHREAD_DEMO
	bool "multi-thread programming demo"
	depends on BR2_PACKAGE_II_VI_APPLICATIONS
	help
		mthread_demo is a demo program to show the multi-threading programming
		API usage in embedded Linux environment.
```

## package/ii-vi/applications/test_script/Config.in
```kconfig
config BR2_PACKAGE_TEST_SCRIPT
	bool "test_script"
	depends on BR2_PACKAGE_II_VI_APPLICATIONS
	help
		test_script is a shell script that prints test messages on standard 
		output.
```

## package/ii-vi/modules/Config.in
```kconfig
menuconfig BR2_PACKAGE_II_VI_MODULES
	bool "ii-vi modules"
	select BR2_PACKAGE_BBB_LED_MOD
	select BR2_PACKAGE_HELLO_WORLD_MOD
	select BR2_PACKAGE_HELLO_WORLD2_MOD
	
source "package/ii-vi/modules/bbb_led_mod/Config.in"
source "package/ii-vi/modules/hello_world_mod/Config.in"
source "package/ii-vi/modules/hello_world2_mod/Config.in"
source "package/ii-vi/modules/mthread_demo_mod/Config.in"
```

## package/ii-vi/modules/bbb_led_mod/Config.in
```kconfig
config BR2_PACKAGE_BBB_LED_MOD
	bool "bbb_led_mod"
	depends on BR2_PACKAGE_II_VI_MODULES
	help
		bbb_led is a kernel module (driver) demo for the control of the USR0 
		LED on BeagleBone Black.
```

## package/ii-vi/modules/hello_world2_mod/Config.in
```kconfig
config BR2_PACKAGE_HELLO_WORLD2_MOD
	bool "hello_world2_mod"
	depends on BR2_PACKAGE_II_VI_MODULES
	help
		hello_world2 is a kernel module (driver) that prints "hello world" and 
		other test messages during kernel load/unload process.
```

## package/ii-vi/modules/hello_world_mod/Config.in
```kconfig
config BR2_PACKAGE_HELLO_WORLD_MOD
	bool "hello_world_mod"
	depends on BR2_PACKAGE_II_VI_MODULES
	help
		hello_world is a kernel module (driver) demo that prints "hello world" 
		message during load/unload process.
```

## package/ii-vi/modules/mthread_demo_mod/Config.in
```kconfig
config BR2_PACKAGE_MTHREAD_DEMO_MOD
	bool "mthread_demo_mod"
	depends on BR2_PACKAGE_II_VI_MODULES
	help
		mthread_demo_mod is a kernel module (driver) demo for the control of the USR0 
		LED on BeagleBone Black with kernel multi-threading capability.
```
